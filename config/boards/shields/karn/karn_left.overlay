#include "karn.dtsi"

&kscan0 {
    col-gpios
        = <&pro_micro 14 GPIO_ACTIVE_HIGH> // Column 6
        , <&pro_micro 15 GPIO_ACTIVE_HIGH> // Column 5
        , <&pro_micro 18 GPIO_ACTIVE_HIGH> // Column 4
        , <&pro_micro 19 GPIO_ACTIVE_HIGH> // Column 3
        , <&pro_micro 20 GPIO_ACTIVE_HIGH> // Column 2
        , <&pro_micro 21 GPIO_ACTIVE_HIGH> // Column 1
        ;
};
